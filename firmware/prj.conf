## CMakeLists.txt
```
cmake_minimum_required(VERSION 3.20.0)
# Work around legacy CMakeLists in transitive OpenAMP/libmetal modules.
set(CMAKE_POLICY_VERSION_MINIMUM 3.5)
find_package(Zephyr REQUIRED HINTS $ENV{ZEPHYR_BASE})
project(firmware)

set(TFLM_ROOT_CANDIDATES
    "${ZEPHYR_BASE}/../modules/tflite-micro"
    "${ZEPHYR_BASE}/../modules/lib/tflite-micro"
    "${ZEPHYR_BASE}/../optional/modules/lib/tflite-micro"
)
foreach(candidate IN LISTS TFLM_ROOT_CANDIDATES)
    if(EXISTS "${candidate}/tensorflow/lite/micro")
        set(TFLM_ROOT "${candidate}")
        break()
    endif()
endforeach()
if(NOT TFLM_ROOT)
    message(FATAL_ERROR "TensorFlow Lite Micro module not found. Checked: ${TFLM_ROOT_CANDIDATES}")
endif()
set(CMSIS_ROOT "${ZEPHYR_BASE}/../modules/lib/cmsis-dsp")
set(CMSIS_NN_ROOT "${ZEPHYR_BASE}/../modules/lib/cmsis-nn")
set(CMSIS_CORE "${ZEPHYR_BASE}/../modules/hal/cmsis")

target_include_directories(app PRIVATE
    include
    "${TFLM_ROOT}"
    "${TFLM_ROOT}/third_party_static/flatbuffers/include"
    "${TFLM_ROOT}/third_party_static/gemmlowp"
    "${TFLM_ROOT}/third_party_static/kissfft"
    "${TFLM_ROOT}/third_party_static/ruy"
    "${TFLM_ROOT}/third_party_static/ruy/include"
    "${CMSIS_ROOT}/Include"
    "${CMSIS_NN_ROOT}"
    "${CMSIS_NN_ROOT}/Include"
    "${CMSIS_CORE}/CMSIS/Core/Include"
    "${CMSIS_CORE}/CMSIS/DSP/Include"
)

file(GLOB_RECURSE TFLM_SOURCES
    "${TFLM_ROOT}/tensorflow/lite/micro/*.cc"
    "${TFLM_ROOT}/tensorflow/lite/micro/*.c"
    "${TFLM_ROOT}/tensorflow/lite/kernels/internal/*.cc"
    "${TFLM_ROOT}/tensorflow/lite/kernels/internal/*.c"
    "${TFLM_ROOT}/tensorflow/lite/core/*.cc"
    "${TFLM_ROOT}/tensorflow/lite/core/*.c"
    "${TFLM_ROOT}/tensorflow/lite/schema/*.cc"
)

set(TFLM_EXTRA_SOURCES
    "${TFLM_ROOT}/tensorflow/lite/kernels/kernel_util.cc"
)

set(TFLM_EXCLUDE_PATTERNS
    "test.cc$"
    "mock"
    "bench"
    "_test_"
    "integration_tests"
    "examples"
    "test_data_generation"
    "/tools/"
    "/python/"
    "/downloads/"
    "/ethos_u/"
    "/hexagon/"
    "/xtensa/"
    "/arc_"
    "/ceva/"
    "bluepill"
    "chre"
    "riscv"
    "apollo3"
    "stm32"
    "himax"
    "esp"
    "cortex_m_corstone_300"
    "cortex_m_generic"
)

foreach(pattern IN LISTS TFLM_EXCLUDE_PATTERNS)
    list(FILTER TFLM_SOURCES EXCLUDE REGEX "${pattern}")
endforeach()

# Use CMSIS-NN kernels where available and exclude duplicate generic kernels.
# For strict parity capture builds we may disable CONFIG_CMSIS_NN to force
# generic/reference TFLM kernels on firmware.
if(CONFIG_CMSIS_NN)
    set(TFLM_KERNELS_TO_REPLACE_WITH_CMSIS_NN
        add
        conv
        depthwise_conv
        fully_connected
        mul
        pooling
        svdf
        transpose_conv
        unidirectional_sequence_lstm
    )

    # Softmax replacement is conditional: keep generic softmax when
    # CONFIG_CMSIS_NN_SOFTMAX is disabled.
    if(CONFIG_CMSIS_NN_SOFTMAX)
        list(APPEND TFLM_KERNELS_TO_REPLACE_WITH_CMSIS_NN softmax)
    else()
        list(FILTER TFLM_SOURCES EXCLUDE REGEX "tensorflow/lite/micro/kernels/cmsis_nn/softmax\.cc$")
    endif()

    foreach(kernel IN LISTS TFLM_KERNELS_TO_REPLACE_WITH_CMSIS_NN)
        list(FILTER TFLM_SOURCES EXCLUDE REGEX "tensorflow/lite/micro/kernels/${kernel}\.cc$")
    endforeach()
else()
    # Reference path: keep generic kernels, drop CMSIS-NN kernel sources.
    list(FILTER TFLM_SOURCES EXCLUDE REGEX "tensorflow/lite/micro/kernels/cmsis_nn/.*\.cc$")
endif()

target_sources(app PRIVATE
    src/main.c
    src/dsp.c
    src/inference.cpp
    src/model.cpp
    src/mel_constants.c
    ${TFLM_SOURCES}
    ${TFLM_EXTRA_SOURCES}
)

function(tinyml_option_from_sysbuild option_name option_help option_default)
    # Resolve sysbuild-propagated values (global and image-local) before defining options.
    zephyr_get(_sysbuild_value VAR ${option_name})
    if(DEFINED _sysbuild_value AND NOT "${_sysbuild_value}" STREQUAL "")
        set(_resolved_default "${_sysbuild_value}")
    else()
        set(_resolved_default "${option_default}")
    endif()
    option(${option_name} "${option_help}" ${_resolved_default})
endfunction()

tinyml_option_from_sysbuild(
    ENABLE_DUAL_CORE_DSP
    "Enable dual-core DSP offload over IPC (cpuapp <-> cpunet)"
    OFF
)
# Sysbuild does not always forward image-local CMake options; when dual-core
# IPC transport is configured (OpenAMP enabled), compile the offload path too.
if(ENABLE_DUAL_CORE_DSP OR CONFIG_OPENAMP)
    target_sources(app PRIVATE src/dual_core_ipc.c)
    target_compile_definitions(app PRIVATE TINYML_DUAL_CORE_DSP_OFFLOAD)
endif()

tinyml_option_from_sysbuild(
    ENABLE_TEST_MODE
    "Enable test-mode sources without Kconfig symbol"
    OFF
)
if(CONFIG_TEST_MODE OR ENABLE_TEST_MODE)
    target_sources(app PRIVATE
        src/data.c
    )
endif()

if(CONFIG_TEST_MODE OR ENABLE_TEST_MODE)
    target_compile_definitions(app PRIVATE TEST_MODE)
endif()

tinyml_option_from_sysbuild(
    TINYML_INCLUDE_BENCHMARK_SOURCES
    "Compile benchmark/export helper sources into the firmware image"
    ON
)
if(TINYML_INCLUDE_BENCHMARK_SOURCES)
    target_sources(app PRIVATE
        src/benchmark.c
        src/test_signals.c
    )
endif()

tinyml_option_from_sysbuild(
    TINYML_EXPORT_C_REFERENCE
    "Build firmware in repeating C reference spectrogram export mode"
    OFF
)
if(TINYML_EXPORT_C_REFERENCE)
    target_compile_definitions(app PRIVATE EXPORT_C_REFERENCE_SPECTROGRAM)
endif()

tinyml_option_from_sysbuild(
    TINYML_EXPORT_QUANTIZED_REFERENCE
    "Build firmware in repeating quantized tensor export mode"
    OFF
)
if(TINYML_EXPORT_QUANTIZED_REFERENCE)
    target_compile_definitions(app PRIVATE EXPORT_QUANTIZED_REFERENCE)
endif()

tinyml_option_from_sysbuild(
    TINYML_WIFI_RUNTIME
    "Enable WiFi initialization at runtime"
    ON
)
tinyml_option_from_sysbuild(
    TINYML_TELEMETRY_SEND_STARTUP
    "Send WIFI_READY telemetry packet at startup"
    ON
)
tinyml_option_from_sysbuild(
    TINYML_TELEMETRY_SEND_TARGET
    "Send target-detection telemetry packets"
    ON
)
tinyml_option_from_sysbuild(
    TINYML_TELEMETRY_SEND_PER_FRAME
    "Send telemetry packet every inference frame"
    OFF
)
tinyml_option_from_sysbuild(
    TINYML_PRINT_STAGE_TIMINGS
    "Print per-frame DSP/NN/end-to-end timing markers"
    ON
)
tinyml_option_from_sysbuild(
    TINYML_POWER_DSP_ONLY
    "Run DSP frontend only in the production loop"
    OFF
)
tinyml_option_from_sysbuild(
    TINYML_POWER_NN_ONLY
    "Run NN inference only in the production loop using a cached spectrogram"
    OFF
)

if(TINYML_WIFI_RUNTIME)
    target_compile_definitions(app PRIVATE TINYML_WIFI_RUNTIME=1)
else()
    target_compile_definitions(app PRIVATE TINYML_WIFI_RUNTIME=0)
endif()

if(TINYML_TELEMETRY_SEND_STARTUP)
    target_compile_definitions(app PRIVATE TINYML_TELEMETRY_SEND_STARTUP=1)
else()
    target_compile_definitions(app PRIVATE TINYML_TELEMETRY_SEND_STARTUP=0)
endif()

if(TINYML_TELEMETRY_SEND_TARGET)
    target_compile_definitions(app PRIVATE TINYML_TELEMETRY_SEND_TARGET=1)
else()
    target_compile_definitions(app PRIVATE TINYML_TELEMETRY_SEND_TARGET=0)
endif()

if(TINYML_TELEMETRY_SEND_PER_FRAME)
    target_compile_definitions(app PRIVATE TINYML_TELEMETRY_SEND_PER_FRAME=1)
else()
    target_compile_definitions(app PRIVATE TINYML_TELEMETRY_SEND_PER_FRAME=0)
endif()

if(TINYML_PRINT_STAGE_TIMINGS)
    target_compile_definitions(app PRIVATE TINYML_PRINT_STAGE_TIMINGS=1)
else()
    target_compile_definitions(app PRIVATE TINYML_PRINT_STAGE_TIMINGS=0)
endif()

if(TINYML_POWER_DSP_ONLY AND TINYML_POWER_NN_ONLY)
    message(FATAL_ERROR "TINYML_POWER_DSP_ONLY and TINYML_POWER_NN_ONLY cannot both be enabled")
endif()

if(TINYML_POWER_DSP_ONLY)
    target_compile_definitions(app PRIVATE TINYML_POWER_DSP_ONLY=1)
else()
    target_compile_definitions(app PRIVATE TINYML_POWER_DSP_ONLY=0)
endif()

if(TINYML_POWER_NN_ONLY)
    target_compile_definitions(app PRIVATE TINYML_POWER_NN_ONLY=1)
else()
    target_compile_definitions(app PRIVATE TINYML_POWER_NN_ONLY=0)
endif()

target_compile_definitions(app PRIVATE TF_LITE_STATIC_MEMORY)
if(CONFIG_CMSIS_NN)
    target_compile_definitions(app PRIVATE CMSIS_NN)
endif()
```

## Kconfig.sysbuild
```
source "${ZEPHYR_BASE}/share/sysbuild/Kconfig"

config TINYML_DUAL_CORE_DSP
	bool "Enable dual-core DSP offload (cpuapp + cpunet)"
	default n

config TINYML_REMOTE_BOARD
	string "Remote board used for DSP service"
	default "nrf7002dk/nrf5340/cpunet" if BOARD_NRF7002DK_NRF5340_CPUAPP
	default "nrf5340dk/nrf5340/cpunet" if BOARD_NRF5340DK_NRF5340_CPUAPP
```

## sysbuild.conf
```
SB_CONFIG_WIFI_NRF70=y
# Enable only for true dual-core DSP offload builds:
# SB_CONFIG_TINYML_DUAL_CORE_DSP=y
```

## prj.conf
```kconfig
# =============================================================================
# nRF7002DK embedded ML benchmark firmware with WiFi telemetry.
# =============================================================================

# --- System ---
CONFIG_GPIO=y
CONFIG_SERIAL=y
CONFIG_PRINTK=y
CONFIG_FPU=y
CONFIG_REGULATOR=y

# --- C++ / Libc ---
CONFIG_CPP=y
CONFIG_STD_CPP17=y
CONFIG_GLIBCXX_LIBCPP=y
CONFIG_NEWLIB_LIBC=y
CONFIG_NEWLIB_LIBC_NANO=y

# --- Optimization ---
CONFIG_SPEED_OPTIMIZATIONS=y

# --- AI / DSP ---
CONFIG_CMSIS_NN=y
CONFIG_CMSIS_NN_ACTIVATION=y
CONFIG_CMSIS_NN_CONVOLUTION=y
CONFIG_CMSIS_NN_FULLYCONNECTED=y
CONFIG_CMSIS_NN_BASICMATH=y
CONFIG_CMSIS_NN_POOLING=y
# Keep CMSIS-NN for core layers; leave Softmax on TFLM reference path
# to reduce cross-runtime 1-LSB parity drift in low-probability classes.
CONFIG_CMSIS_NN_SOFTMAX=n
CONFIG_CMSIS_DSP=y
CONFIG_CMSIS_DSP_FASTMATH=y
CONFIG_CMSIS_DSP_TRANSFORM=y
CONFIG_CMSIS_DSP_MATRIX=y
# CONFIG_CMSIS_DSP_DISTANCE is not needed - we only use TRANSFORM (FFT)
CONFIG_CMSIS_DSP_COMPLEXMATH=y

# nRF5340 cpuapp has no Zephyr D-cache maintenance path; keep buffer alignment
# and explicit coherency hooks guarded in code for portable reuse.

# =============================================================================
# WiFi Configuration (from Nordic sta sample)
# =============================================================================
CONFIG_WIFI=y
CONFIG_WIFI_NRF70=y
CONFIG_NRF70_QSPI_LOW_POWER=n
CONFIG_NRF_WIFI_IF_AUTO_START=y
CONFIG_WIFI_NM_WPA_SUPPLICANT=y
CONFIG_WIFI_READY_LIB=y
CONFIG_NRF_WIFI_RPU_RECOVERY=y
CONFIG_WIFI_MGMT_EXT=y
CONFIG_WIFI_CREDENTIALS=y
CONFIG_WIFI_CREDENTIALS_STATIC=y
# Placeholder credentials only. Override locally with:
#   -DEXTRA_CONF_FILE=firmware/prj.local.conf
# and define CONFIG_WIFI_CREDENTIALS_STATIC_SSID / PASSWORD there.
CONFIG_WIFI_CREDENTIALS_STATIC_SSID="YOUR_SSID"
CONFIG_WIFI_CREDENTIALS_STATIC_PASSWORD="YOUR_PASSWORD"

# =============================================================================
# Networking (from Nordic sta sample)
# =============================================================================
CONFIG_NETWORKING=y
CONFIG_NET_SOCKETS=y
CONFIG_NET_LOG=y
CONFIG_NET_IPV4=y
CONFIG_NET_UDP=y
# Use hotspot DHCP instead of a fixed LAN address
CONFIG_NET_DHCPV4=y
CONFIG_NET_PKT_RX_COUNT=8
CONFIG_NET_PKT_TX_COUNT=8
CONFIG_NET_BUF_RX_COUNT=8
CONFIG_NET_BUF_TX_COUNT=16
CONFIG_NRF70_RX_NUM_BUFS=16
CONFIG_HEAP_MEM_POOL_SIZE=200000
CONFIG_HEAP_MEM_POOL_IGNORE_MIN=y
CONFIG_NET_TC_TX_COUNT=1
CONFIG_NET_IF_UNICAST_IPV4_ADDR_COUNT=1
CONFIG_NET_MAX_CONTEXTS=5
CONFIG_NET_CONTEXT_SYNC_RECV=y
CONFIG_INIT_STACKS=y
CONFIG_NET_L2_ETHERNET=y
CONFIG_NET_CONFIG_SETTINGS=y
CONFIG_NET_CONFIG_INIT_TIMEOUT=0
# Hotspot deployments use DHCP-assigned IPv4 settings.
# Enable ARP
CONFIG_NET_ARP=y
CONFIG_NET_SOCKETS_POLL_MAX=10

# Disable IPv6 to save RAM
CONFIG_NET_IPV6=n
CONFIG_NET_TCP=n

# =============================================================================
# Memory (adjusted for AI + WiFi)
# =============================================================================
CONFIG_MAIN_STACK_SIZE=8192
CONFIG_NET_TX_STACK_SIZE=4096
CONFIG_NET_RX_STACK_SIZE=4096
CONFIG_SYSTEM_WORKQUEUE_STACK_SIZE=4096
CONFIG_NET_MGMT_EVENT_STACK_SIZE=4096

# =============================================================================
# Kernel / logging
# =============================================================================
CONFIG_ENTROPY_GENERATOR=y
CONFIG_LOG=y
CONFIG_LOG_BUFFER_SIZE=2048
CONFIG_LOG_MODE_DEFERRED=y
CONFIG_POSIX_CLOCK=y
CONFIG_NET_MGMT_EVENT_QUEUE_TIMEOUT=5000
```

## prj_c_ref.conf
```kconfig
# Export-only overlay for deterministic C reference capture.
# Keep runtime close to normal firmware but avoid auto network init and
# increase main stack for benchmark/dump path.
CONFIG_GPIO=y
CONFIG_SERIAL=y
CONFIG_PRINTK=y
CONFIG_FPU=y
CONFIG_REGULATOR=y

CONFIG_CPP=y
CONFIG_STD_CPP17=y
CONFIG_GLIBCXX_LIBCPP=y
CONFIG_NEWLIB_LIBC=y
CONFIG_NEWLIB_LIBC_NANO=y

CONFIG_CMSIS_DSP=y
CONFIG_CMSIS_DSP_FASTMATH=y
CONFIG_CMSIS_DSP_TRANSFORM=y
CONFIG_CMSIS_DSP_MATRIX=y
CONFIG_CMSIS_DSP_COMPLEXMATH=y

CONFIG_NET_CONFIG_AUTO_INIT=n
CONFIG_MAIN_STACK_SIZE=32768

# C-reference export must not drop UART lines (C_REF_BEGIN/C_REF_END).
# Route printk directly instead of deferred logging backend.
CONFIG_LOG=n
CONFIG_LOG_PRINTK=n
```

## prj_dualcore.conf
```kconfig
# Enable true app-core <-> net-core IPC transport for DSP offload.
CONFIG_SOC_NRF53_CPUNET_ENABLE=y
CONFIG_OPENAMP=y
CONFIG_OPENAMP_SLAVE=n
CONFIG_IPC_SERVICE=y
CONFIG_IPC_SERVICE_BACKEND_RPMSG=y
CONFIG_MBOX=y

# Avoid deferred logging delays during IPC benchmarking.
CONFIG_LOG_MODE_DEFERRED=n
```

## prj_inference_only.conf
```kconfig
# =============================================================================
# Standalone constrained inference profile
# =============================================================================

# --- System ---
CONFIG_GPIO=y
CONFIG_SERIAL=y
CONFIG_PRINTK=y
CONFIG_FPU=y
CONFIG_REGULATOR=y
CONFIG_ENTROPY_GENERATOR=y

# --- C++ / Libc ---
CONFIG_CPP=y
CONFIG_STD_CPP17=y
CONFIG_GLIBCXX_LIBCPP=y
CONFIG_NEWLIB_LIBC=y
CONFIG_NEWLIB_LIBC_NANO=y

# --- Optimization ---
CONFIG_SPEED_OPTIMIZATIONS=y

# --- AI / DSP ---
CONFIG_CMSIS_NN=y
CONFIG_CMSIS_NN_ACTIVATION=y
CONFIG_CMSIS_NN_CONVOLUTION=y
CONFIG_CMSIS_NN_FULLYCONNECTED=y
CONFIG_CMSIS_NN_BASICMATH=y
CONFIG_CMSIS_NN_POOLING=y
CONFIG_CMSIS_NN_SOFTMAX=n
CONFIG_CMSIS_DSP=y
CONFIG_CMSIS_DSP_FASTMATH=y
CONFIG_CMSIS_DSP_TRANSFORM=y
CONFIG_CMSIS_DSP_MATRIX=y
CONFIG_CMSIS_DSP_COMPLEXMATH=y

# --- Memory / Runtime ---
CONFIG_HEAP_MEM_POOL_SIZE=32768
CONFIG_MAIN_STACK_SIZE=4096
CONFIG_SYSTEM_WORKQUEUE_STACK_SIZE=2048
CONFIG_INIT_STACKS=n

# --- Logging ---
CONFIG_LOG=n
CONFIG_LOG_PRINTK=n
```

## prj_qref.conf
```kconfig
# Quantized reference export overlay for deterministic UART capture.
# Keep runtime deterministic and avoid log buffering that can drop markers.
CONFIG_GPIO=y
CONFIG_SERIAL=y
CONFIG_PRINTK=y
CONFIG_FPU=y
CONFIG_REGULATOR=y

CONFIG_CPP=y
CONFIG_STD_CPP17=y
CONFIG_GLIBCXX_LIBCPP=y
CONFIG_NEWLIB_LIBC=y
CONFIG_NEWLIB_LIBC_NANO=y

CONFIG_CMSIS_DSP=y
CONFIG_CMSIS_DSP_FASTMATH=y
CONFIG_CMSIS_DSP_TRANSFORM=y
CONFIG_CMSIS_DSP_MATRIX=y
CONFIG_CMSIS_DSP_COMPLEXMATH=y

CONFIG_NET_CONFIG_AUTO_INIT=n
CONFIG_MAIN_STACK_SIZE=32768
CONFIG_LOG=n
CONFIG_LOG_PRINTK=n

# Strict quantized parity capture: use generic/reference TFLM kernels
# so firmware parity target matches Python TFLite reference behavior.
CONFIG_CMSIS_NN=n
```

## prj_usb_console.conf
```kconfig
CONFIG_USB_DEVICE_STACK=y
CONFIG_USB_CDC_ACM=y
CONFIG_USB_DEVICE_INITIALIZE_AT_BOOT=n
CONFIG_USB_DEVICE_PRODUCT="nRF Embedded ML Console"
CONFIG_USB_DEVICE_MANUFACTURER="nrf-embedded-ml-benchmarks"

CONFIG_CONSOLE=y
CONFIG_UART_CONSOLE=y
CONFIG_UART_LINE_CTRL=y

CONFIG_USE_SEGGER_RTT=n
CONFIG_RTT_CONSOLE=n
```

## include/benchmark.h
```c
#ifndef BENCHMARK_H
#define BENCHMARK_H

/**
 * Performance Benchmarking Framework
 *
 * Provides accurate timing measurements for DSP and inference operations
 * to verify optimization claims.
 */

#ifdef __cplusplus
extern "C" {
#endif

/**
 * Run all benchmarks and print results to console
 *
 * Call this during initialization to verify performance claims:
 * - DSP Frontend latency
 * - Neural network inference latency
 * - End-to-end pipeline latency
 */
void run_benchmarks(void);

/**
 * Benchmark DSP frontend (mel spectrogram computation)
 */
void benchmark_dsp(void);

/**
 * Benchmark neural network inference only
 */
void benchmark_inference(void);

/**
 * Benchmark complete pipeline (DSP + Inference)
 */
void benchmark_end_to_end(void);

/**
 * Export only the C reference spectrogram dump.
 *
 * This path intentionally skips inference setup/benchmarking to keep
 * cross-platform DSP equivalence capture deterministic and lightweight.
 */
void export_c_reference_only(void);

/**
 * Export quantized inference tensors for cross-platform int8 parity checks.
 *
 * Emits UART markers:
 * - QREF_BEGIN input_bytes=<n> output_bytes=<m>
 * - QREF_IN <idx> <int8>
 * - QREF_OUT <idx> <int8>
 * - QREF_END
 */
void export_quantized_reference_only(void);

#ifdef __cplusplus
}
#endif

#endif
```

## include/data.h
```c
#ifndef DATA_H
#define DATA_H

#include <stdint.h>

#define SAMPLE_RATE     16000
#define NUM_SAMPLES     16000

#define FFT_SIZE        512
#define NUM_FFT_BINS    257
#define NUM_MEL_BINS    40
#define WINDOW_STEP     320
#define SPECTROGRAM_ROWS 49
#define SPECTROGRAM_SIZE (SPECTROGRAM_ROWS * NUM_MEL_BINS)

#ifndef PI
#define PI 3.14159265358979323846f
#endif

#ifdef TEST_MODE
extern const int16_t audio_cat2[NUM_SAMPLES];
extern const int16_t audio_on2[NUM_SAMPLES];
#endif

#endif
```

## include/dsp.h
```c
#ifndef DSP_H
#define DSP_H
#include <stdint.h>

int generate_spectrogram(const int16_t* waveform, float* spectrogram);

#endif
```

## include/dual_core_ipc.h
```c
#ifndef DUAL_CORE_IPC_H
#define DUAL_CORE_IPC_H

#include <stdint.h>

#ifdef __cplusplus
extern "C" {
#endif

int dual_core_dsp_init(void);
int dual_core_generate_spectrogram(const int16_t *audio_in, float *features_out);
int dual_core_dsp_ready(void);

#ifdef __cplusplus
}
#endif

#endif
```

## include/dual_core_protocol.h
```c
#ifndef DUAL_CORE_PROTOCOL_H
#define DUAL_CORE_PROTOCOL_H

#include <stdint.h>
#include "data.h"

#define TINYML_DSP_IPC_EP_NAME "tinyml_dsp_ep"

#define TINYML_DSP_IPC_MAX_CHUNK_SAMPLES 240U

enum tinyml_dsp_ipc_cmd {
    TINYML_DSP_CMD_FRAME_START = 1,
    TINYML_DSP_CMD_FRAME_CHUNK = 2,
    TINYML_DSP_CMD_FRAME_END = 3,
    TINYML_DSP_CMD_FRAME_RESULT = 4
};

struct tinyml_dsp_ipc_header {
    uint8_t cmd;
    uint8_t frame_idx;
    uint16_t payload_len;
} __attribute__((packed));

struct tinyml_dsp_ipc_chunk_prefix {
    uint16_t offset;
    uint16_t count;
} __attribute__((packed));

struct tinyml_dsp_ipc_result_payload {
    float mel[NUM_MEL_BINS];
} __attribute__((packed));

#endif
```

## include/inference.h
```c
#ifndef INFERENCE_H
#define INFERENCE_H

#include <stdint.h>
#include <stddef.h>

#ifdef __cplusplus
extern "C" {
#endif

/**
 * Initialize TensorFlow Lite Micro inference engine
 * @return 0 on success, -1 on failure
 */
int inference_setup(void);

/**
 * Run inference on spectrogram data
 *
 * @param spectrogram_data Input spectrogram (49x40 float array)
 * @param output_probability Output parameter - probability of "ON" class (0.0-1.0)
 * @return 0 on completed inference, -1 on runtime failure.
 *
 * A low-confidence result is still a completed inference; thresholding belongs to the caller.
 */
int run_inference(const float* spectrogram_data, float* output_probability);

/**
 * Query configured tensor arena size for logging/diagnostics.
 *
 * @return Tensor arena size in bytes.
 */
uint32_t inference_tensor_arena_size(void);

/**
 * Copy latest quantized model input tensor produced by run_inference().
 *
 * @param out Destination buffer.
 * @param out_len Destination capacity in bytes.
 * @return Number of bytes copied, or -1 on invalid arguments / unavailable data.
 */
int inference_copy_last_quantized_input(int8_t *out, size_t out_len);

/**
 * Copy latest quantized model output tensor produced by run_inference().
 *
 * @param out Destination buffer.
 * @param out_len Destination capacity in bytes.
 * @return Number of bytes copied, or -1 on invalid arguments / unavailable data.
 */
int inference_copy_last_quantized_output(int8_t *out, size_t out_len);

#ifdef __cplusplus
}
#endif

#endif
```

## include/mel_constants.h
```c
#ifndef MEL_CONSTANTS_H
#define MEL_CONSTANTS_H

#include "data.h"

/*
 * Dense log-mel projection matrix for CMSIS-DSP matrix operations.
 *
 * Layout is row-major [mel_bin][fft_bin] so it can be passed directly
 * to arm_mat_vec_mult_f32() with the FFT magnitude vector.
 */
#define MEL_FILTERBANK_ROWS NUM_MEL_BINS
#define MEL_FILTERBANK_COLS NUM_FFT_BINS
#define MEL_FILTERBANK_DENSE_SIZE (MEL_FILTERBANK_ROWS * MEL_FILTERBANK_COLS)

extern const float mel_filterbank_dense[MEL_FILTERBANK_DENSE_SIZE];

#endif
```

## include/model.h
```c
#ifndef MODEL_H
#define MODEL_H

#ifdef __cplusplus
extern "C" {
#endif

extern const unsigned char g_model[];
extern const unsigned int g_model_len;

#ifdef __cplusplus
}
#endif

#endif 
```

## include/reference_signal.h
```c
#ifndef REFERENCE_SIGNAL_H
#define REFERENCE_SIGNAL_H

#include <stdint.h>
#include "data.h"

/*
 * Deterministic integer-only reference signal used by both firmware and
 * host-side DSP verification. Integer arithmetic avoids libm differences
 * (for example sinf/logf implementation drift) in the stimulus path.
 */
static inline void generate_bit_exact_reference_signal(int16_t *buffer) {
    uint32_t lcg = 0xC001D00Du;
    uint32_t xorshift = 0x1BADB002u;

    for (int i = 0; i < NUM_SAMPLES; i++) {
        lcg = lcg * 1664525u + 1013904223u;

        xorshift ^= xorshift << 13;
        xorshift ^= xorshift >> 17;
        xorshift ^= xorshift << 5;

        int32_t a = (int32_t)((lcg >> 16) & 0x7FFu) - 1024;
        int32_t b = (int32_t)(xorshift & 0x3FFu) - 512;

        int32_t sample = a * 24 + b * 12;
        buffer[i] = (int16_t)sample;
    }
}

#endif
```

## include/test_signals.h
```c
#ifndef TEST_SIGNALS_H
#define TEST_SIGNALS_H

#include <stdint.h>
#include "data.h"

#ifdef __cplusplus
extern "C" {
#endif

void generate_sine_wave(int16_t* buffer, float frequency_hz, float amplitude);
void generate_white_noise(int16_t* buffer, float amplitude);
void generate_silence(int16_t* buffer);
void generate_chirp(int16_t* buffer, float f_start_hz, float f_end_hz, float amplitude);
void generate_multi_tone(int16_t* buffer, const float* frequencies, int num_tones, float amplitude);

#ifdef __cplusplus
}
#endif

#endif
```

## include/wifi_credentials.h
```c
#ifndef WIFI_CREDENTIALS_H
#define WIFI_CREDENTIALS_H

/*
 * WiFi Telemetry Configuration
 *
 * WiFi credentials are configured via Kconfig using
 * CONFIG_WIFI_CREDENTIALS_STATIC_SSID and CONFIG_WIFI_CREDENTIALS_STATIC_PASSWORD.
 */

#define TELEMETRY_IP    "192.0.2.1"
#define TELEMETRY_PORT  8080

#endif
```

## src/benchmark.c
```c
#include <zephyr/kernel.h>
#include <zephyr/sys/printk.h>
#include <stdint.h>
#include "dsp.h"
#include "inference.h"
#include "data.h"
#include "test_signals.h"
#include "reference_signal.h"

#define WARMUP_RUNS 10
#define BENCHMARK_RUNS 100

#ifndef BENCHMARK_BASELINE_MS
#define BENCHMARK_BASELINE_MS 0
#endif

static int16_t test_audio[NUM_SAMPLES];
static float features[SPECTROGRAM_SIZE];
#ifdef EXPORT_QUANTIZED_REFERENCE
static int8_t qref_input[SPECTROGRAM_SIZE];
static int8_t qref_output[16];
#endif

enum benchmark_signal_kind {
    SIGNAL_SINE,
    SIGNAL_WHITE_NOISE,
    SIGNAL_CHIRP,
    SIGNAL_SILENCE,
};

struct benchmark_signal_case {
    const char* name;
    enum benchmark_signal_kind kind;
    float freq1;
    float freq2;
    float amplitude;
};

static void fill_benchmark_signal(const struct benchmark_signal_case *test)
{
    switch (test->kind) {
    case SIGNAL_SINE:
        generate_sine_wave(test_audio, test->freq1, test->amplitude);
        break;
    case SIGNAL_WHITE_NOISE:
        generate_white_noise(test_audio, test->amplitude);
        break;
    case SIGNAL_CHIRP:
        generate_chirp(test_audio, test->freq1, test->freq2, test->amplitude);
        break;
    case SIGNAL_SILENCE:
        generate_silence(test_audio);
        break;
    }
}

static uint32_t measure_spectrogram_us(void)
{
    for (int i = 0; i < WARMUP_RUNS; i++) {
        generate_spectrogram(test_audio, features);
    }

    uint32_t start = k_cycle_get_32();
    for (int i = 0; i < BENCHMARK_RUNS; i++) {
        generate_spectrogram(test_audio, features);
    }
    uint32_t end = k_cycle_get_32();

    return k_cyc_to_us_near32((end - start) / BENCHMARK_RUNS);
}

static double rate_per_second(uint32_t avg_us)
{
    return avg_us > 0U ? 1000000.0 / (double)avg_us : 0.0;
}

#ifdef EXPORT_C_REFERENCE_SPECTROGRAM
static void dump_c_reference_spectrogram(void) {
    generate_bit_exact_reference_signal(test_audio);

    if (generate_spectrogram(test_audio, features) != 0) {
        printk("C_REF_ERROR spectrogram_generation_failed\n");
        return;
    }

    printk("C_REF_BEGIN rows=%d cols=%d\n", SPECTROGRAM_ROWS, NUM_MEL_BINS);
    for (int i = 0; i < SPECTROGRAM_SIZE; i++) {
        union {
            float f;
            uint32_t u;
        } bits = { .f = features[i] };
        printk("C_REF %d %.9f 0x%08x\n", i, (double)features[i], bits.u);
        // Throttle UART output to avoid dropped log lines that can
        // truncate the reference block (especially C_REF_BEGIN).
        if ((i & 0x0F) == 0x0F) {
            k_msleep(1);
        }
    }
    printk("C_REF_END\n");
}
#endif

static void benchmark_dsp_variety(void) {
    printk("\n=== DSP Benchmark (Various Signals) ===\n");

    const struct benchmark_signal_case test_signals[] = {
        {"Sine 1kHz", SIGNAL_SINE, 1000.0f, 0.0f, 0.5f},
        {"Sine 3kHz", SIGNAL_SINE, 3000.0f, 0.0f, 0.5f},
        {"White Noise", SIGNAL_WHITE_NOISE, 0.0f, 0.0f, 0.5f},
        {"Chirp 100-4k", SIGNAL_CHIRP, 100.0f, 4000.0f, 0.5f},
        {"Silence", SIGNAL_SILENCE, 0.0f, 0.0f, 0.0f},
    };

    const int num_tests = sizeof(test_signals) / sizeof(test_signals[0]);

    for (int t = 0; t < num_tests; t++) {
        fill_benchmark_signal(&test_signals[t]);
        uint32_t avg_us = measure_spectrogram_us();

        printk("  %-15s: %5u us (%.3f ms)\n",
               test_signals[t].name, avg_us, (double)((float)avg_us / 1000.0f));
    }
}

void benchmark_dsp(void) {
    printk("\n=== DSP Benchmark ===\n");

    float frequencies[] = {500.0f, 1500.0f, 3000.0f};
    generate_multi_tone(test_audio, frequencies, 3, 0.3f);

    for (int i = 0; i < WARMUP_RUNS; i++) {
        generate_spectrogram(test_audio, features);
    }

    uint32_t start = k_cycle_get_32();
    for (int i = 0; i < BENCHMARK_RUNS; i++) {
        generate_spectrogram(test_audio, features);
    }
    uint32_t end = k_cycle_get_32();

    uint32_t total_cycles = end - start;
    uint32_t avg_us = k_cyc_to_us_near32(total_cycles / BENCHMARK_RUNS);

    printk("DSP Frontend (Mel Spectrogram):\n");
    printk("  Runs: %d\n", BENCHMARK_RUNS);
    printk("  Total: %u cycles\n", total_cycles);
    printk("  Average: %u us (%.3f ms)\n", avg_us, (double)((float)avg_us / 1000.0f));
    printk("  Throughput: %.1f fps\n", rate_per_second(avg_us));

    printk("  Per-frame (49 FFTs):\n");
    printk("    Total per frame: %u us\n", avg_us);
    printk("    Per FFT: ~%u us\n", avg_us / 49);
}

void benchmark_inference(void) {
    printk("\n=== Inference Benchmark ===\n");

    for (int i = 0; i < SPECTROGRAM_SIZE; i++) {
        features[i] = 0.0f;
    }

    float probability;

    for (int i = 0; i < WARMUP_RUNS; i++) {
        run_inference(features, &probability);
    }

    uint32_t start = k_cycle_get_32();
    for (int i = 0; i < BENCHMARK_RUNS; i++) {
        run_inference(features, &probability);
    }
    uint32_t end = k_cycle_get_32();

    uint32_t total_cycles = end - start;
    uint32_t avg_us = k_cyc_to_us_near32(total_cycles / BENCHMARK_RUNS);
    float avg_ms = (float)avg_us / 1000.0f;

    printk("Neural Network Inference:\n");
    printk("  Runs: %d\n", BENCHMARK_RUNS);
    printk("  Total: %u cycles\n", total_cycles);
    printk("  Average: %u us (%.3f ms)\n", avg_us, (double)avg_ms);
    printk("  Throughput: %.1f inferences/sec\n", rate_per_second(avg_us));

    printk("\nOptimization Summary:\n");
    printk("  Current: ~%.3f ms\n", (double)avg_ms);
    if (BENCHMARK_BASELINE_MS > 0 && avg_ms > 0.0f) {
        double speedup = (double)BENCHMARK_BASELINE_MS / (double)avg_ms;
        double reduction_percent =
            (1.0 - ((double)avg_ms / (double)BENCHMARK_BASELINE_MS)) * 100.0;

        printk("  Baseline (configured): ~%d ms\n", BENCHMARK_BASELINE_MS);
        printk("  Speedup: %.1fx\n", speedup);
        printk("  Reduction: %.2f%%\n", reduction_percent);
    } else {
        printk("  Baseline: not configured (set BENCHMARK_BASELINE_MS to compare)\n");
    }
}

void benchmark_end_to_end(void) {
    printk("\n=== End-to-End Benchmark ===\n");

    float frequencies[] = {500.0f, 1500.0f, 3000.0f};
    generate_multi_tone(test_audio, frequencies, 3, 0.3f);

    float probability;

    for (int i = 0; i < WARMUP_RUNS; i++) {
        generate_spectrogram(test_audio, features);
        run_inference(features, &probability);
    }

    uint32_t start = k_cycle_get_32();
    for (int i = 0; i < BENCHMARK_RUNS; i++) {
        generate_spectrogram(test_audio, features);
        run_inference(features, &probability);
    }
    uint32_t end = k_cycle_get_32();

    uint32_t total_cycles = end - start;
    uint32_t avg_us = k_cyc_to_us_near32(total_cycles / BENCHMARK_RUNS);

    printk("Full Pipeline (DSP + Inference):\n");
    printk("  Average latency: %u us (%.3f ms)\n", avg_us, (double)((float)avg_us / 1000.0f));
    printk("  Real-time factor: %.2fx\n", rate_per_second(avg_us));
}

void run_benchmarks(void) {
    printk("\n");
    printk("===============================================================\n");
    printk("   Performance Benchmarking Framework\n");
    printk("===============================================================\n");
    printk("Platform: nRF5340 @ %d MHz\n", SystemCoreClock / 1000000);
    printk("Compiler: GCC %s\n", __VERSION__);
    printk("Optimization: %s\n",
        #if defined(__OPTIMIZE_SIZE__)
            "Size (-Os)"
        #elif defined(__OPTIMIZE__)
            "Speed (-O2/O3)"
        #else
            "Debug (-O0)"
        #endif
    );

    benchmark_dsp();
    benchmark_dsp_variety();
    benchmark_inference();
    benchmark_end_to_end();

#ifdef EXPORT_C_REFERENCE_SPECTROGRAM
    printk("\n=== C Reference Spectrogram Dump ===\n");
    dump_c_reference_spectrogram();
#endif

#ifdef EXPORT_QUANTIZED_REFERENCE
    printk("\n=== Quantized Tensor Reference Dump ===\n");
    export_quantized_reference_only();
#endif

    printk("\n===============================================================\n");
    printk("Benchmark complete. Compare results to documented claims.\n");
    printk("===============================================================\n\n");
}

void export_c_reference_only(void) {
#ifdef EXPORT_C_REFERENCE_SPECTROGRAM
    printk("\n=== C Reference Spectrogram Dump (DSP only) ===\n");
    dump_c_reference_spectrogram();
#else
    printk("C reference export disabled (build without EXPORT_C_REFERENCE_SPECTROGRAM)\n");
#endif
}

void export_quantized_reference_only(void) {
#ifdef EXPORT_QUANTIZED_REFERENCE
    generate_bit_exact_reference_signal(test_audio);

    if (generate_spectrogram(test_audio, features) != 0) {
        printk("QREF_ERROR spectrogram_generation_failed\n");
        return;
    }

    float probability = 0.0f;
    if (run_inference(features, &probability) != 0) {
        printk("QREF_ERROR inference_failed\n");
        return;
    }

    int input_bytes = inference_copy_last_quantized_input(qref_input, sizeof(qref_input));
    int output_bytes = inference_copy_last_quantized_output(qref_output, sizeof(qref_output));
    if (input_bytes <= 0 || output_bytes <= 0) {
        printk("QREF_ERROR tensor_capture_failed in=%d out=%d\n", input_bytes, output_bytes);
        return;
    }

    printk("QREF_BEGIN input_bytes=%d output_bytes=%d prob=%.9f\n",
           input_bytes, output_bytes, (double)probability);

    for (int i = 0; i < input_bytes; i++) {
        printk("QREF_IN %d %d\n", i, (int)qref_input[i]);
        if ((i & 0x1F) == 0x1F) {
            k_msleep(1);
        }
    }

    for (int i = 0; i < output_bytes; i++) {
        printk("QREF_OUT %d %d\n", i, (int)qref_output[i]);
    }

    printk("QREF_END\n");
#else
    printk("Quantized reference export disabled (build without EXPORT_QUANTIZED_REFERENCE)\n");
#endif
}
```
